## config/west.yml
```yaml
manifest:
  remotes:
    - name: dmun
      url-base: https://github.com/dmun
  projects:
    - name: zmk
      remote: dmun
      revision: mikoto_7_1_0
      import: app/west.yml
  self:
    path: config
```
